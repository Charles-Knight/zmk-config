## config/boards/shields/zaphod_lite/boards/seeeduino_xiao_ble.conf
```kconfig
CONFIG_SPI=y

# Enable/Disable Sleep
# CONFIG_ZMK_SLEEP=y
# CONFIG_ZMK_IDLE_SLEEP_TIMEOUT=1050000
```

## config/boards/shields/zaphod_lite/zaphod_lite_defconfig
```kconfig
# Enable display and options
CONFIG_ZMK_DISPLAY=y
CONFIG_LV_USE_THEME_MONO=n
CONFIG_LV_COLOR_CHROMA_KEY_HEX=0x00FF00
CONFIG_ZMK_WIDGET_BATTERY_STATUS=y
CONFIG_ZMK_WIDGET_OUTPUT_STATUS=y
CONFIG_ZMK_WIDGET_LAYER_STATUS=y
```

## config/west.yml
```yaml
manifest:
  remotes:
    - name: zmkfirmware
      url-base: https://github.com/zmkfirmware
    - name: jlw # Module for le jlwffre
      url-base: https://github.com/josh-l-wang
  projects:
    - name: zmk
      remote: zmkfirmware
      revision: main
      import: app/west.yml
    - name: zmk-jlw-keyboards # Project for le jlwffre
      remote: jlw
      revision: main # This is the name of the branch you want to use.
  self:
    path: config
```
